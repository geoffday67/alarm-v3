/*
 * File:   main.c
 * Author: geoff
 *
 * Created on September 20, 2026, 10:17 PM
 */

// CONFIG1
#pragma config FEXTOSC = OFF    // External Oscillator Mode Selection bits (EC (external clock) 16 MHz and above)
#pragma config RSTOSC = HFINTOSC_32MHZ// Power-up Default Value for COSC bits (main() then drops HFINTOSC to 4 MHz via OSCFRQ)
#pragma config CLKOUTEN = OFF   // Clock Out Enable bit (CLKOUT function is disabled; I/O function on RA4)
#pragma config VDDAR = LO       // VDD Range Analog Calibration Selection bit

// CONFIG2
#pragma config MCLRE = EXTMCLR  // Master Clear Enable bit (If LVP = 0, MCLR pin is MCLR; If LVP = 1, RA3 pin function is MCLR)
#pragma config PWRTS = PWRT_OFF // Power-up Timer Selection bits (PWRT is disabled)
#pragma config WDTE = OFF
#pragma config BOREN = OFF      // Brown-out Reset Enable bits (Brown-out Reset disabled)
#pragma config BORV = LO        // Brown-out Reset Voltage Selection bit (Brown-out Reset Voltage (VBOR) set to 1.9V)
#pragma config PPS1WAY = ON     // PPSLOCKED One-Way Set Enable bit (The PPSLOCKED bit can be set once after an unlocking sequence is executed; once PPSLOCKED is set, all future changes to PPS registers are prevented)
#pragma config STVREN = ON      // Stack Overflow/Underflow Reset Enable bit (Stack Overflow or Underflow will cause a reset)

// CONFIG3

// CONFIG4
#pragma config BBSIZE = BB512   // Boot Block Size Selection bits (512 words boot block size)
#pragma config BBEN = OFF       // Boot Block Enable bit (Boot Block is disabled)
#pragma config SAFEN = OFF      // SAF Enable bit (SAF is disabled)
#pragma config WRTAPP = OFF     // Application Block Write Protection bit (Application Block is not write-protected)
#pragma config WRTB = OFF       // Boot Block Write Protection bit (Boot Block is not write-protected)
#pragma config WRTC = OFF       // Configuration Registers Write Protection bit (Configuration Registers are not write-protected)
#pragma config WRTSAF = OFF     // Storage Area Flash (SAF) Write Protection bit (SAF is not write-protected)
#pragma config LVP = ON         // Low Voltage Programming Enable bit (Low Voltage programming enabled. MCLR/Vpp pin function is MCLR. MCLRE Configuration bit is ignored.)

// CONFIG5
#pragma config CP = OFF         // User Program Flash Memory Code Protection bit (User Program Flash Memory code protection is disabled)

/*
 * PIC16F15225, PDIP-14 (top view)
 *
 *                 +----U----+
 *           VDD --| 1    14 |-- VSS
 *           RA5 --| 2    13 |-- RA0/ICSPDAT
 *           RA4 --| 3    12 |-- RA1/ICSPCLK
 * /MCLR/VPP/RA3 --| 4    11 |-- RA2
 *           RC5 --| 5    10 |-- RC0
 *           RC4 --| 6     9 |-- RC1
 *           RC3 --| 7     8 |-- RC2
 *                 +---------+
 */

/*
 * RA5 - eInk front light.
 * RA4 - Unused.
 * RC5 - Unused.
 * RC4 - Unused.
 * RC3 - Unused.
 * RC2 - PDLC driver enable (high = on).
 * RC1 (SDA), RC0 (SCL) - I2C.
 * RA2 - Moomin light (opto-coupler drive, ~500 ms pulse).
 * 
 * Unused pins are driven low as outputs to avoid floating-input current in sleep.
 */

#define _XTAL_FREQ 4000000     // Must match the OSCFRQ setting at the start of main() (HFINTOSC 4 MHz)

// Must match PIC_I2C_ADDRESS in the ESP32 project's Constants.h
#define I2C_CLIENT_ADDRESS 0x08

// Commands sent as the single data byte in the I2C packet. Must match ESP32 constants.
// EINK_LIGHT_ON fades the front light on and the PIC turns it off itself after
// EINK_LIGHT_ON_TIME_MS (a repeat ON restarts the time). EINK_LIGHT_ON_HOLD
// fades it on with no time limit (cancelling any on-time already running),
// so it stays on until EINK_LIGHT_OFF. EINK_LIGHT_OFF fades it off, however
// it was turned on.
#define I2C_COMMAND_EINK_LIGHT_ON 0x01
#define I2C_COMMAND_EINK_LIGHT_OFF 0x02
#define I2C_COMMAND_PDLC_ON 0x03
#define I2C_COMMAND_PDLC_OFF 0x04
#define I2C_COMMAND_PULSE_MOOMIN 0x05
#define I2C_COMMAND_EINK_LIGHT_ON_HOLD 0x06

// eInk front light control (RA5, see pin table above). The LEDs are driven
// directly from the pin through a series resistor (100R measured at 5.2 mA,
// within the 6 mA VOH-characterised range, D370). Active high (pin high =
// light on). Fades in/out using CCP1 PWM - see the eInk fade section below.
// Turns itself off after EINK_LIGHT_ON_TIME_MS, timed by Timer1 - see the eInk
// on-time section below.
#define EINK_LIGHT_LAT  LATAbits.LATA5
#define EINK_LIGHT_TRIS TRISAbits.TRISA5

// Moomin light (RA2, see pin table above). Drives an opto-coupler: active
// high, pulsed for ~500 ms. Plain LAT output - RA2PPS resets to 0x00 (LATA2,
// Table 18-2) and is never changed.
#define MOOMIN_LAT  LATAbits.LATA2
#define MOOMIN_TRIS TRISAbits.TRISA2

// PDLC driver enable (RC2, see pin table above). Active high. The square-wave
// drive is generated by the external PDLC driver, not the PIC. Plain LAT
// output - RC2PPS resets to 0x00 (LATC2, Table 18-2) and is never changed.
#define PDLC_ENABLE_LAT  LATCbits.LATC2
#define PDLC_ENABLE_TRIS TRISCbits.TRISC2

#include <xc.h>

int einkFading = 0;
int canSleep = 1;

// Moomin pulse: RA2 high for ~500 ms, timed by Timer0 so no blocking and no
// clock stretching. Timer0 runs asynchronously from LFINTOSC, so it keeps
// counting in Sleep and its interrupt flag wakes the device (19.2.2, 19.4);
// LFINTOSC stays running in Sleep while a peripheral uses it (13.1).
// TMR0IE is in PIE0, so it doesn't need PEIE (12.9.2 note 2). The main loop
// calls endMoominPulse() when TMR0IF sets. Calling this again during a pulse
// restarts the 500 ms.

void pulseMoomin() {
    T0CON0 = 0; // Timer0 off, 8-bit mode, 1:1 postscaler
    T0CON1bits.CS = 0b100; // LFINTOSC (Table 19-1)
    T0CON1bits.ASYNC = 1; // not synchronised to FOSC, so it runs in Sleep
    T0CON1bits.CKPS = 0b0111; // 1:128 -> 31 kHz / 128 = 4.13 ms per tick
    // 8-bit mode: TMR0L counts 0..TMR0H then resets and sets TMR0IF (19.1.1).
    // 121 ticks x 4.13 ms = ~500 ms nominal; LFINTOSC is 26.5-36 kHz (OS53),
    // so the actual pulse is ~430-585 ms.
    TMR0H = 120;
    TMR0L = 0; // also clears the prescaler (19.2.3)
    PIR0bits.TMR0IF = 0;
    PIE0bits.TMR0IE = 1; // lets the period match wake the device

    MOOMIN_LAT = 1;
    T0CON0bits.EN = 1;
}

void endMoominPulse() {
    MOOMIN_LAT = 0;
    T0CON0bits.EN = 0;
    PIE0bits.TMR0IE = 0;
    PIR0bits.TMR0IF = 0;
}

// --- Timer2 PWM timebase (eInk light only) ---
// CCP PWM uses Timer2 for its period (22.4.2). Period (Eq. 22-1):
// (T2PR + 1) * 4 * Tosc * prescale
//   = 256 * 4 * 0.25 us * 16 = 4.096 ms -> 244.1 Hz at FOSC = 4 MHz.
// T2PR = 255 gives the full 10-bit duty resolution (1024 counts, 22.4.5).
// Other prescales with the same T2PR (so all duty values stay valid):
//   0b110 1:64 -> 61 Hz, 0b101 1:32 -> 122 Hz, 0b011 1:8 -> 488 Hz.
// Note the eInk fade steps once per period, so its duration scales too.
#define T2_PERIOD     255
#define T2_PRESCALE   0b100                  // 1:16 (T2CON CKPS)
#define PWM_DUTY_FULL (4 * (T2_PERIOD + 1))  // 1024 = 100% (Eq. 22-3)

// Start Timer2 if it isn't already running. T2TMR is preloaded to T2PR so the
// first period match - which latches the double-buffered duty value (22.4.3)
// - happens on the first tick (16 us) rather than after a full period.

void timer2Acquire(void) {
    if (T2CONbits.ON) {
        return;
    }
    T2PR = T2_PERIOD;
    T2CLKCON = 0b0001; // CS = FOSC/4 - required for PWM (Table 21-3, 22.4.9)
    T2CON = T2_PRESCALE << 4; // ON = 0, CKPS = prescale, OUTPS = 1:1 (TMR2IF every period)
    PIR1bits.TMR2IF = 0;
    T2TMR = T2_PERIOD;
    T2CONbits.ON = 1;
}

// Stop Timer2 once the eInk fade no longer needs it.

void timer2Release(void) {
    if (!einkFading) {
        T2CONbits.ON = 0;
    }
}

// --- PDLC driver enable ---
// The external driver generates the film's AC drive; the PIC just switches it
// on and off via RC2. A plain LAT output keeps its level in Sleep (13.1), so
// the PIC can sleep while the PDLC is on.

void startPDLC(void) {
    PDLC_ENABLE_LAT = 1;
}

void stopPDLC(void) {
    PDLC_ENABLE_LAT = 0;
}

// --- eInk front light fade (RA5) ---
// CCP1 PWM on RA5, stepped once per Timer2 period (TMR2IF) by
// EINK_FADE_INCREMENT levels, so a fade takes EINK_FADE_STEPS /
// EINK_FADE_INCREMENT periods: 64 x 4.096 ms = ~0.26 s at 244 Hz (increment 1
// gives ~0.52 s, 4 gives ~0.13 s). Brightness uses
// duty = level^2 / 16 (level 0-128 -> duty 0-1024): a rough match to perceived
// brightness that only needs a 16-bit multiply and a shift.
// Between fades RA5 is a plain LAT output (fully on or fully off), so Timer2
// can stop and the PIC can sleep. The PIC stays awake only while fading, since
// CCP PWM freezes in Sleep (22.4.6). A new command mid-fade just reverses the
// direction from the current level.
#define EINK_FADE_STEPS 128
#define EINK_FADE_INCREMENT 2  // levels per Timer2 period

#if EINK_FADE_STEPS != 128 || T2_PERIOD != 255
#error "einkSetDuty()'s level^2/16 mapping assumes 128 steps and a 1024 full-scale duty"
#endif

unsigned char einkLevel = 0; // 0 = off, EINK_FADE_STEPS = fully on
unsigned char einkTarget = 0;

void einkSetDuty(unsigned char level) {
    unsigned int duty = ((unsigned int) level * level) >> 4; // 128^2 / 16 = 1024
    // CCPR1 is 10 bits, so 1024 can't be written - it would wrap to 0 and
    // blank the first period of a fade-out from fully on. 1023 = 99.9%.
    if (duty > 1023) {
        duty = 1023;
    }
    CCPR1H = (unsigned char) (duty >> 8); // FMT = 0 (right aligned): CCPR1H[1:0] = duty[9:8]
    CCPR1L = (unsigned char) duty; // duty[7:0]
}

void startEinkFade(unsigned char on) {
    einkTarget = on ? EINK_FADE_STEPS : 0;

    // Mid-fade: the new target just reverses direction from the current level.
    // Not fading and already there: nothing to do.
    if (einkFading || einkLevel == einkTarget) {
        return;
    }

    einkSetDuty(einkLevel); // start from the current level (0 or full)
    CCP1CON = 0x8C; // EN = 1, FMT = 0 (right aligned), MODE = 1100 (PWM, Table 22-5)
    einkFading = 1;
    timer2Acquire();

    // The first fade step (which hands RA5 to CCP1) must only happen after a
    // period match following the duty write above - i.e. after it has latched
    // - so a fade-out from fully on doesn't blink off. timer2Acquire() already
    // clears TMR2IF when it starts Timer2; this keeps that true even if Timer2
    // were ever left running.
    PIR1bits.TMR2IF = 0;
}

// Called once per Timer2 period while fading.

void einkFadeStep(void) {
    if (RA5PPS != 0x01) {
        RA5PPS = 0x01; // first period of the fade: hand RA5 to CCP1 (Table 18-2)
    }

    // Step towards the target, landing exactly on it on the last step
    if (einkLevel < einkTarget) {
        einkLevel = (einkTarget - einkLevel > EINK_FADE_INCREMENT)
                ? einkLevel + EINK_FADE_INCREMENT : einkTarget;
    } else if (einkLevel > einkTarget) {
        einkLevel = (einkLevel - einkTarget > EINK_FADE_INCREMENT)
                ? einkLevel - EINK_FADE_INCREMENT : einkTarget;
    }

    if (einkLevel == einkTarget) {
        // Fade complete: back to a plain LAT output and CCP1 off
        EINK_LIGHT_LAT = (einkLevel != 0);
        RA5PPS = 0x00; // LATA5
        CCP1CON = 0;
        einkFading = 0;
        timer2Release();
    } else {
        einkSetDuty(einkLevel);
    }
}

// --- eInk front light on-time (Timer1) ---
// The light turns itself off EINK_LIGHT_ON_TIME_MS after the last ON command,
// so the ESP32 doesn't have to time it (and can deep sleep meanwhile).
// Timer1 counts LFINTOSC asynchronously (SYNC = 1), so it keeps running in
// Sleep and its overflow sets TMR1IF and wakes the device (20.8). TMR1IE is
// in PIE1, so it also needs PEIE, which main() sets (12.9.3). 20.8 also lists
// GIE, but wake-up only needs the peripheral enable bits (13.1.1) - the same
// as Timer0 and the MSSP rely on here.
// Timer0 isn't used because the Moomin pulse owns it; Timer2 isn't because
// it's the PWM timebase, must run from FOSC/4, and so stops in Sleep.
// LFINTOSC / 8 = 3.875 kHz -> 0.258 ms per tick, so the 16-bit overflow
// allows up to ~16.9 s nominal. LFINTOSC is 26.5-36 kHz (OS53), so 4 s
// nominal is actually ~3.4-4.7 s.
#define EINK_LIGHT_ON_TIME_MS 4000UL
#define EINK_LIGHT_TICKS ((EINK_LIGHT_ON_TIME_MS * 31UL) / 8UL) // 31 kHz / 8 prescale
#define EINK_LIGHT_TIMER_PRELOAD (65536UL - EINK_LIGHT_TICKS)   // overflows after EINK_LIGHT_TICKS

#if EINK_LIGHT_TICKS > 65535UL
#error "EINK_LIGHT_ON_TIME_MS is too long for Timer1 at LFINTOSC / 8"
#endif

// T1CON (20.11.1): CKPS = 11 (1:8), SYNC = 1 (asynchronous, runs in Sleep),
// RD16 = 0 (TMR1H/TMR1L written directly), ON = 0. Written as a whole byte;
// OR in T1CON_ON to start.
#define T1CON_EINK_STOPPED 0x34
#define T1CON_ON           0x01
#define T1CLK_LFINTOSC     0b00100 // T1CLK CS (Table 20-4)

// Start, or restart, the on-time. The timer is stopped while TMR1 is written,
// as recommended for asynchronous mode (20.4.1).

void startEinkLightTimer(void) {
    T1CON = T1CON_EINK_STOPPED;
    T1GCON = 0; // GE = 0: counts whenever ON = 1 (Table 20-1)
    T1CLK = T1CLK_LFINTOSC;
    TMR1H = (unsigned char) (EINK_LIGHT_TIMER_PRELOAD >> 8);
    TMR1L = (unsigned char) EINK_LIGHT_TIMER_PRELOAD; // also clears the prescaler (20.3)
    PIR1bits.TMR1IF = 0;
    PIE1bits.TMR1IE = 1; // lets the overflow wake the device
    T1CON = T1CON_EINK_STOPPED | T1CON_ON;
}

void stopEinkLightTimer(void) {
    T1CON = T1CON_EINK_STOPPED;
    PIE1bits.TMR1IE = 0;
    PIR1bits.TMR1IF = 0;
}

// Fade the light on and start (or restart) the on-time. An ON during the
// fade-out reverses it, as startEinkFade() handles.

void einkLightOn(void) {
    startEinkFade(1);
    startEinkLightTimer();
}

// Fade the light on with no on-time: it stays on until einkLightOff(). Any
// on-time already running from an ON is cancelled.

void einkLightOnHold(void) {
    stopEinkLightTimer();
    startEinkFade(1);
}

// Fade the light off - at the end of the on-time, or on an OFF command.

void einkLightOff(void) {
    stopEinkLightTimer();
    startEinkFade(0);
}

void processReceivedByte(unsigned char byte) {
    switch (byte) {
        case I2C_COMMAND_EINK_LIGHT_ON:
            einkLightOn();
            break;
        case I2C_COMMAND_EINK_LIGHT_OFF:
            einkLightOff();
            break;
        case I2C_COMMAND_EINK_LIGHT_ON_HOLD:
            einkLightOnHold();
            break;
        case I2C_COMMAND_PDLC_ON:
            startPDLC();
            break;
        case I2C_COMMAND_PDLC_OFF:
            stopPDLC();
            break;
        case I2C_COMMAND_PULSE_MOOMIN:
            pulseMoomin();
            break;
    }
}

void main(void) {
    // --- System clock: HFINTOSC 4 MHz ---
    // RSTOSC starts HFINTOSC at 32 MHz. Run at 4 MHz for lower active current
    // (originally chosen so Timer2 PWM could reach ~50 Hz for the PDLC).
    // 100 kHz I2C client still OK (needs FOSC >= 1.5 MHz, Table 32-22).
    OSCFRQbits.FRQ = 0b010; // 4 MHz (11.3.4)
    while (!OSCSTATbits.HFOR); // wait until HFINTOSC is ready at the new frequency (11.2.2)

    ANSELA = 0x00; // RA2, RA5 digital (both have analog functions by default)

    EINK_LIGHT_TRIS = 0; // RA5 as output
    EINK_LIGHT_LAT = 0; // light off initially

    // --- Unused pins: outputs driven low ---
    // Floating digital inputs draw switching current in Sleep (datasheet 13.1);
    // 4.5 recommends unused pins as outputs driven low. LAT is written before
    // TRIS so no pin briefly drives high. RA0/RA1 are the ICSP pins - safe to
    // drive here, since TRIS resets to 1 (input) and the device is held in
    // Reset while being programmed.
    LATAbits.LATA0 = 0;
    LATAbits.LATA1 = 0;
    LATAbits.LATA4 = 0;
    TRISAbits.TRISA0 = 0;
    TRISAbits.TRISA1 = 0;
    TRISAbits.TRISA4 = 0;

    LATCbits.LATC3 = 0;
    LATCbits.LATC4 = 0;
    LATCbits.LATC5 = 0;
    TRISCbits.TRISC3 = 0;
    TRISCbits.TRISC4 = 0;
    TRISCbits.TRISC5 = 0;

    // --- Moomin light (RA2): off until pulseMoomin() ---
    MOOMIN_LAT = 0;
    MOOMIN_TRIS = 0;

    // --- PDLC driver enable (RC2): off until startPDLC() ---
    // Until these lines run (and during any Reset or programming) RC2 is an
    // input, since TRIS resets to 1 - an external pull-down keeps the driver
    // off then, unless its enable input already has one.
    PDLC_ENABLE_LAT = 0;
    PDLC_ENABLE_TRIS = 0;

    // --- I2C client (MSSP1) setup, RC0 = SCL1, RC1 = SDA1 ---
    ANSELC = 0x00; // RC0/RC1 digital - ANSEL resets to analog, which disables the
    // digital input buffer, including for PPS peripheral inputs (16.5).
    // RC2-RC5 are driven outputs, so analog/digital doesn't matter for them.
    TRISCbits.TRISC0 = 1; // SCL1 as input - module drives it open-drain internally
    TRISCbits.TRISC1 = 1; // SDA1 as input

    SSP1CLKPPS = 0x10; // RC0 (PORTC=010, PIN=000) -> SSP1 clock input
    SSP1DATPPS = 0x11; // RC1 (PORTC=010, PIN=001) -> SSP1 data input
    RC0PPS = 0x07; // RC0 -> SCL1/SCK1 output
    RC1PPS = 0x08; // RC1 -> SDA1/SDO1 output

    SSP1ADD = (I2C_CLIENT_ADDRESS << 1); // 7-bit client address goes in bits 7:1
    SSP1CON2bits.SEN = 1; // enable clock stretching after each received byte
    SSP1CON1 = 0x36; // SSPEN=1, CKP=1 (clock released/idle), SSPM=0110 (I2C client, 7-bit)

    // Sleep between I2C packets. PIE1bits.SSP1IE is required for the MSSP
    // module to be able to wake the device from Sleep on an address match or
    // completed byte transfer (datasheet 25.2.4.1.7). INTCONbits.PEIE is also required -
    // without it, ALL PIE1/PIE2 peripheral interrupts (including SSP1IE) stay
    // disabled regardless of their individual enable bit (12.9.2, note 2).
    // GIE is deliberately left off - wake-up only needs PEIE + the peripheral
    // interrupt enable bit, not GIE (13.1.1), and with GIE off execution just
    // resumes at the instruction after SLEEP() instead of vectoring into an
    // ISR, which keeps the existing polling structure below unchanged.
    PIE1bits.SSP1IE = 1;
    INTCONbits.PEIE = 1;

    while (1) {
        if (canSleep && !einkFading) {
            SLEEP();
        } else {
            // Poll for I2C packet - busy-wait for the next SSP1IF instead of
            // sleeping, since we're mid-transaction (address byte already
            // matched) and re-entering Sleep between bytes was the suspected
            // cause of the data byte failing to wake the device.
            // Also exits on TMR0IF so a Moomin pulse ends on time while awake,
            // and on TMR1IF so the eInk light's on-time ends on time too.
            // While mid-transaction (canSleep == 0) it also exits on a Stop
            // condition, in case the host sent only an address byte and no
            // data byte (e.g. a bus probe) - see below.
            // While fading it also exits on each Timer2 period (TMR2IF).
            while (!PIR1bits.SSP1IF && !PIR0bits.TMR0IF && !PIR1bits.TMR1IF
                    && !(einkFading && PIR1bits.TMR2IF)
                    && (canSleep || !SSP1STATbits.P));
        }

        // eInk fade step, once per Timer2 period
        if (einkFading && PIR1bits.TMR2IF) {
            PIR1bits.TMR2IF = 0;
            einkFadeStep();
        }

        // Address matched but the host then sent Stop with no data byte.
        // Without this, canSleep would stay 0 until the next transaction.
        // P = "Stop was detected last" (25.4.4); it is clear between the
        // address and data bytes of a normal transaction, because the Start
        // before the address byte cleared it. With PCIE clear, polling P is
        // the only way to see the Stop (25.2.3.6.2, step 15).
        if (!canSleep && SSP1STATbits.P) {
            canSleep = 1;
        }

        // End of Moomin pulse (Timer0 period match - also wakes from Sleep)
        if (PIR0bits.TMR0IF) {
            endMoominPulse();
        }

        // End of the eInk light on-time (Timer1 overflow - also wakes from
        // Sleep). Before the I2C service below, so an ON arriving in the same
        // pass restarts the light rather than being undone.
        if (PIR1bits.TMR1IF) {
            einkLightOff();
        }

        // Service any pending I2C byte (address match or a data byte).
        // Hardware ACKs automatically on match; firmware just needs to clear
        // SSP1IF, read SSP1BUF to clear BF, and set CKP again since SEN=1
        // stretches the clock low after every byte.
        if (PIR1bits.SSP1IF) {
            PIR1bits.SSP1IF = 0;
            unsigned char receivedByte = SSP1BUF; // clears BF
            if (SSP1STATbits.D_nA) { // 1 = data byte, 0 = address byte
                processReceivedByte(receivedByte);
                canSleep = 1;
            } else {
                canSleep = 0;
            }

            SSP1CON1bits.CKP = 1;
        }
    }
}
